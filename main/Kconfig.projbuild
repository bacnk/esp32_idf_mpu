## main/Kconfig.projbuild
```kconfig
menu "Example Configuration"

    config ESP_WIFI_SSID
        string "WiFi SSID"
        default "myssid"
        help
            SSID (network name) for the example to connect to.

    config ESP_WIFI_PASSWORD
        string "WiFi Password"
        default "mypassword"
        help
            WiFi password (WPA or WPA2) for the example to use.

    config ESP_MAXIMUM_RETRY
        int "Maximum retry"
        default 5
        help
            Set the Maximum retry to avoid station reconnecting to the AP unlimited when the AP is really inexistent.
endmenu
menu "CONFIG TCP SERVER"
    config SERVER_IP
    string "Server IP"
    default "192.168.1.100"
    help
        Enter the IP address of the server.

config SERVER_PORT
    int "Server Port"
    default 1234
    help
        Enter the port number of the server.
endmenu
```
